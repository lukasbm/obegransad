## components/ikea-obegransad-panel/Kconfig.projbuild
```kconfig
menu "Driver for IKEA Obegransad Panel"

    choice OBG_PANEL_BACKEND
        prompt "Panel backend"
        default OBG_PANEL_BACKEND_SIM if OBG_SIMULATOR
        default OBG_PANEL_BACKEND_HW
        help
            Hardware uses SPI + RMT + GPIO shift-register output. The
            simulator publishes frames to the host renderer and touches no
            peripherals (for QEMU/host builds).

    config OBG_PANEL_BACKEND_HW
        bool "Hardware (SPI + RMT + GPIO)"

    config OBG_PANEL_BACKEND_SIM
        bool "Simulator (framebuffer over TCP)"
    endchoice

    config MY_DISPLAY_OE_PIN
        int "OE Pin"
        default 6
        help
            GPIO number for Output Enable (OE) pin.

    config MY_DISPLAY_DI_PIN
        int "DI Pin"
        default 5
        help
            GPIO number for Data In (DI) pin.

    config MY_DISPLAY_CLK_PIN
        int "CLK Pin"
        default 4
        help
            GPIO number for Clock (CLK) pin.

    config MY_DISPLAY_LATCH_PIN
        int "LATCH Pin"
        default 3
        help
            GPIO number for Latch (LATCH) pin.

endmenu
```

## components/obegransad-sim/Kconfig.projbuild
```kconfig
menu "Simulator link"

    config OBG_SIM_HOST
        string "Host address of the simulator renderer"
        default "10.0.2.2" if !IDF_TARGET_LINUX
        default "127.0.0.1" if IDF_TARGET_LINUX
        help
            Address the firmware connects to for the simulator renderer.
            Under QEMU this must be 10.0.2.2 (slirp's alias for the host);
            on a host build 127.0.0.1.

    config OBG_SIM_PORT
        int "TCP port of the simulator renderer"
        range 1024 65535
        default 5566
        help
            Port the host renderer listens on (tools/sim/renderer.py).

endmenu
```

## main/Kconfig.projbuild
```kconfig
menu "Obegransad Configuration"

config OBG_WIFI_SSID
    string "WiFi SSID"
    default ""
    help
        SSID of the WiFi network to connect to. Leave empty to fall back to the
        captive portal for provisioning.

config OBG_WIFI_PASSWORD
    string "WiFi password"
    default ""
    help
        Password for the WiFi network. Leave empty for an open network.

config OBG_TIMEZONE
    string "POSIX timezone string"
    default "CET-1CEST,M3.5.0,M10.5.0/3"
    help
        POSIX TZ string, e.g. "CET-1CEST,M3.5.0,M10.5.0/3". See
        https://github.com/nayarsystems/posix_tz_db.

config OBG_WEATHER_LATITUDE
    string "Weather latitude"
    default "0.0"
    help
        Latitude for the weather scenes, as a decimal string (e.g. "49.45").
        Leave at 0.0 to disable weather fetching.

config OBG_WEATHER_LONGITUDE
    string "Weather longitude"
    default "0.0"
    help
        Longitude for the weather scenes, as a decimal string (e.g. "11.08").

config OBG_ANNIVERSARY_DAY
    int "Anniversary day (1-31)"
    range 1 31
    default 1

config OBG_ANNIVERSARY_MONTH
    int "Anniversary month (1-12)"
    range 1 12
    default 1

config OBG_SCENE_DWELL_MS
    int "Default scene dwell (ms)"
    range 1000 600000
    default 10000
    help
        Default time each scene is shown before the rotation advances
        (milliseconds). Presets carry their own dwell; this is the value the
        "Everything" preset uses. See main/presets.hpp.

config OBG_POPUP_MS
    int "Popup duration (ms)"
    range 250 10000
    default 2000
    help
        How long the fullscreen popups (preset number, Wi-Fi lost/regained)
        stay on screen before the normal rendering resumes.

config OBG_WIFI_DOWN_GRACE_MS
    int "Wi-Fi disconnect grace period (ms)"
    range 1000 120000
    default 10000
    help
        How long the Wi-Fi link must stay down before the app reports it as
        disconnected. This rides out the driver's own reconnect attempts, which
        would otherwise flap the display between OPERATIONAL and DEGRADED.

config OBG_SIMULATOR
    bool "Simulator build (QEMU/host, no real hardware)"
    default n
    help
        Selects the simulator backends (display over TCP, emulated Ethernet
        instead of esp_wifi, renderer-driven button). Used by
        tools/sim/run-qemu.sh via sdkconfig.defaults.sim; the hardware build
        must keep this off.

choice OBG_DEVICE_BACKEND
    prompt "Device/connectivity backend"
    default OBG_DEVICE_BACKEND_HOST if IDF_TARGET_LINUX
    default OBG_DEVICE_BACKEND_SIM if OBG_SIMULATOR
    default OBG_DEVICE_BACKEND_HW

    config OBG_DEVICE_BACKEND_HW
        bool "Hardware (esp-wifi-connect + esp_wifi)"

    config OBG_DEVICE_BACKEND_SIM
        bool "Simulator (QEMU emulated Ethernet, no esp_wifi)"

    config OBG_DEVICE_BACKEND_HOST
        bool "Host (native Linux, host network stack)"
endchoice

choice OBG_BUTTON_BACKEND
    prompt "Button backend"
    default OBG_BUTTON_BACKEND_SIM if IDF_TARGET_LINUX
    default OBG_BUTTON_BACKEND_SIM if OBG_SIMULATOR
    default OBG_BUTTON_BACKEND_HW

    config OBG_BUTTON_BACKEND_HW
        bool "Hardware (poll GPIO)"

    config OBG_BUTTON_BACKEND_SIM
        bool "Simulator (commands from the renderer)"
endchoice

config OBG_SIM_FAKE_NO_CREDS
    bool "Simulator: pretend no Wi-Fi credentials are configured"
    depends on OBG_SIMULATOR
    default n
    help
        Makes wifi_has_credentials() return false so the app boots into the
        SETUP state. The captive portal itself cannot run outside real
        hardware; only the state/UI path is exercised.

config OBG_HTTP_PORT
    int "HTTP config server port"
    range 1 65535
    default 8080 if IDF_TARGET_LINUX
    default 80
    help
        Port the built-in config server (docs/openapi.yaml) listens on. The
        device and QEMU use 80 (run-qemu.sh forwards host 8080 to guest 80);
        the native host build defaults to 8080 because binding port 80 needs
        privileges.

endmenu
```
